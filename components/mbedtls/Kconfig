## components/mbedtls/Kconfig
```kconfig
#TODO add depens for CONFIG_HOST (bk7231u)
menu "Mbedtls"
	config MBEDTLS
		bool "Enable Mbedtls"
		default n
	config FULL_MBEDTLS
		depends on MBEDTLS
		bool "Enable Full Mbedtls"
		default n
	config NWY_MBEDTLS_FILE_CONFIG
		bool "NWY_NEED_FILE"
		default y
endmenu
```
